## external/package/libretro-potator/Config.in
```kconfig
config BR2_PACKAGE_LIBRETRO_POTATOR
	bool "libretro-potator"
	help
	  libretro core: Watara Supervision.

	  https://github.com/libretro/potator
```

## external/package/libretro-prboom/Config.in
```kconfig
config BR2_PACKAGE_LIBRETRO_PRBOOM
	bool "libretro-prboom"
	help
	  libretro core: DOOM engine.

	  https://github.com/libretro/libretro-prboom
```

## external/package/libretro-prosystem/Config.in
```kconfig
config BR2_PACKAGE_LIBRETRO_PROSYSTEM
	bool "libretro-prosystem"
	help
	  libretro core: Atari 7800.

	  https://github.com/libretro/prosystem-libretro
```

## external/package/libretro-puae2021/Config.in
```kconfig
config BR2_PACKAGE_LIBRETRO_PUAE2021
	bool "libretro-puae2021"
	help
	  libretro core: Commodore Amiga (PUAE 2021).
```

## external/package/libretro-race/Config.in
```kconfig
config BR2_PACKAGE_LIBRETRO_RACE
	bool "libretro-race"
	help
	  libretro core: Neo Geo Pocket / Color.

	  https://github.com/libretro/RACE
```

## external/package/libretro-snes9x2002/Config.in
```kconfig
config BR2_PACKAGE_LIBRETRO_SNES9X2002
	bool "libretro-snes9x2002"
	help
	  libretro core: Super Nintendo (fastest).

	  https://github.com/libretro/snes9x2002
```

## external/package/libretro-snes9x2005/Config.in
```kconfig
config BR2_PACKAGE_LIBRETRO_SNES9X2005
	bool "libretro-snes9x2005"
	help
	  libretro core: Super Nintendo.

	  https://github.com/libretro/snes9x2005
```

## external/package/libretro-stella2014/Config.in
```kconfig
config BR2_PACKAGE_LIBRETRO_STELLA2014
	bool "libretro-stella2014"
	help
	  libretro core: Atari 2600.

	  https://github.com/libretro/stella2014-libretro
```

## external/package/libretro-vecx/Config.in
```kconfig
config BR2_PACKAGE_LIBRETRO_VECX
	bool "libretro-vecx"
	help
	  libretro core: Vectrex.

	  https://github.com/libretro/libretro-vecx
```

## external/package/libretro-vice/Config.in
```kconfig
config BR2_PACKAGE_LIBRETRO_VICE
	bool "libretro-vice"
	help
	  libretro core: Commodore 64 (VICE x64).
```

## external/package/retroarch/Config.in
```kconfig
config BR2_PACKAGE_RETROARCH
	bool "retroarch"
	depends on BR2_INSTALL_LIBSTDCPP
	select BR2_PACKAGE_SDL
	select BR2_PACKAGE_ALSA_LIB
	select BR2_PACKAGE_EUDEV
	select BR2_PACKAGE_ZLIB
	select BR2_PACKAGE_OPENSSL
	select BR2_PACKAGE_LIBSHAKE
	help
	  RetroArch, built with the upstream OpenDingux beta (rg350_odbeta)
	  target: SDL 1.2 "sdl_dingux" video driver with IPU scaling.

	  https://www.retroarch.com
```
