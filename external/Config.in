## external/Config.in
```kconfig
menu "RG350M-SYS"

config BR2_PACKAGE_RG350M_SYS
	bool "RG350M-SYS frontend and emulators"
	select BR2_PACKAGE_EMULATIONSTATION
	select BR2_PACKAGE_RETROARCH
	select BR2_PACKAGE_ES_THEME_CARBON
	select BR2_PACKAGE_LIBRETRO_VICE
	select BR2_PACKAGE_LIBRETRO_PUAE2021
	select BR2_PACKAGE_LIBRETRO_FAKE08
	select BR2_PACKAGE_LIBRETRO_ATARI800
	select BR2_PACKAGE_LIBRETRO_BLUEMSX
	select BR2_PACKAGE_LIBRETRO_CAP32
	select BR2_PACKAGE_LIBRETRO_FBALPHA2012
	select BR2_PACKAGE_LIBRETRO_FCEUMM
	select BR2_PACKAGE_LIBRETRO_FREEINTV
	select BR2_PACKAGE_LIBRETRO_FUSE
	select BR2_PACKAGE_LIBRETRO_GAMBATTE
	select BR2_PACKAGE_LIBRETRO_GENESIS_PLUS_GX
	select BR2_PACKAGE_LIBRETRO_GPSP
	select BR2_PACKAGE_LIBRETRO_GW
	select BR2_PACKAGE_LIBRETRO_HANDY
	select BR2_PACKAGE_LIBRETRO_MAME2003_PLUS
	select BR2_PACKAGE_LIBRETRO_MEDNAFEN_PCE_FAST
	select BR2_PACKAGE_LIBRETRO_MEDNAFEN_WSWAN
	select BR2_PACKAGE_LIBRETRO_NESTOPIA
	select BR2_PACKAGE_LIBRETRO_NXENGINE
	select BR2_PACKAGE_LIBRETRO_O2EM
	select BR2_PACKAGE_LIBRETRO_PCSX_REARMED
	select BR2_PACKAGE_LIBRETRO_PICODRIVE
	select BR2_PACKAGE_LIBRETRO_POKEMINI
	select BR2_PACKAGE_LIBRETRO_POTATOR
	select BR2_PACKAGE_LIBRETRO_PRBOOM
	select BR2_PACKAGE_LIBRETRO_PROSYSTEM
	select BR2_PACKAGE_LIBRETRO_RACE
	select BR2_PACKAGE_LIBRETRO_SNES9X2002
	select BR2_PACKAGE_LIBRETRO_SNES9X2005
	select BR2_PACKAGE_LIBRETRO_STELLA2014
	select BR2_PACKAGE_LIBRETRO_VECX
	help
	  EmulationStation, RetroArch and the libretro cores that run
	  well on the JZ4770.

source "$BR2_EXTERNAL_RG350M_SYS_PATH/package/emulationstation/Config.in"
source "$BR2_EXTERNAL_RG350M_SYS_PATH/package/retroarch/Config.in"
source "$BR2_EXTERNAL_RG350M_SYS_PATH/package/es-theme-carbon/Config.in"

menu "libretro cores"
source "$BR2_EXTERNAL_RG350M_SYS_PATH/package/libretro-vice/Config.in"
source "$BR2_EXTERNAL_RG350M_SYS_PATH/package/libretro-puae2021/Config.in"
source "$BR2_EXTERNAL_RG350M_SYS_PATH/package/libretro-fake08/Config.in"
source "$BR2_EXTERNAL_RG350M_SYS_PATH/package/libretro-atari800/Config.in"
source "$BR2_EXTERNAL_RG350M_SYS_PATH/package/libretro-bluemsx/Config.in"
source "$BR2_EXTERNAL_RG350M_SYS_PATH/package/libretro-cap32/Config.in"
source "$BR2_EXTERNAL_RG350M_SYS_PATH/package/libretro-fbalpha2012/Config.in"
source "$BR2_EXTERNAL_RG350M_SYS_PATH/package/libretro-fceumm/Config.in"
source "$BR2_EXTERNAL_RG350M_SYS_PATH/package/libretro-freeintv/Config.in"
source "$BR2_EXTERNAL_RG350M_SYS_PATH/package/libretro-fuse/Config.in"
source "$BR2_EXTERNAL_RG350M_SYS_PATH/package/libretro-gambatte/Config.in"
source "$BR2_EXTERNAL_RG350M_SYS_PATH/package/libretro-genesis-plus-gx/Config.in"
source "$BR2_EXTERNAL_RG350M_SYS_PATH/package/libretro-gpsp/Config.in"
source "$BR2_EXTERNAL_RG350M_SYS_PATH/package/libretro-gw/Config.in"
source "$BR2_EXTERNAL_RG350M_SYS_PATH/package/libretro-handy/Config.in"
source "$BR2_EXTERNAL_RG350M_SYS_PATH/package/libretro-mame2003-plus/Config.in"
source "$BR2_EXTERNAL_RG350M_SYS_PATH/package/libretro-mednafen-pce-fast/Config.in"
source "$BR2_EXTERNAL_RG350M_SYS_PATH/package/libretro-mednafen-wswan/Config.in"
source "$BR2_EXTERNAL_RG350M_SYS_PATH/package/libretro-nestopia/Config.in"
source "$BR2_EXTERNAL_RG350M_SYS_PATH/package/libretro-nxengine/Config.in"
source "$BR2_EXTERNAL_RG350M_SYS_PATH/package/libretro-o2em/Config.in"
source "$BR2_EXTERNAL_RG350M_SYS_PATH/package/libretro-pcsx-rearmed/Config.in"
source "$BR2_EXTERNAL_RG350M_SYS_PATH/package/libretro-picodrive/Config.in"
source "$BR2_EXTERNAL_RG350M_SYS_PATH/package/libretro-pokemini/Config.in"
source "$BR2_EXTERNAL_RG350M_SYS_PATH/package/libretro-potator/Config.in"
source "$BR2_EXTERNAL_RG350M_SYS_PATH/package/libretro-prboom/Config.in"
source "$BR2_EXTERNAL_RG350M_SYS_PATH/package/libretro-prosystem/Config.in"
source "$BR2_EXTERNAL_RG350M_SYS_PATH/package/libretro-race/Config.in"
source "$BR2_EXTERNAL_RG350M_SYS_PATH/package/libretro-snes9x2002/Config.in"
source "$BR2_EXTERNAL_RG350M_SYS_PATH/package/libretro-snes9x2005/Config.in"
source "$BR2_EXTERNAL_RG350M_SYS_PATH/package/libretro-stella2014/Config.in"
source "$BR2_EXTERNAL_RG350M_SYS_PATH/package/libretro-vecx/Config.in"
endmenu

endmenu
```

## external/package/emulationstation/Config.in
```kconfig
config BR2_PACKAGE_EMULATIONSTATION
	bool "emulationstation"
	depends on BR2_INSTALL_LIBSTDCPP
	depends on BR2_PACKAGE_HAS_LIBGLES
	select BR2_PACKAGE_SDL2
	select BR2_PACKAGE_FREETYPE
	select BR2_PACKAGE_LIBFREEIMAGE
	select BR2_PACKAGE_LIBCURL
	select BR2_PACKAGE_RAPIDJSON
	select BR2_PACKAGE_ALSA_LIB
	help
	  RetroPie EmulationStation, built with the OpenGL ES 2.0
	  renderer and without libVLC.

	  https://github.com/RetroPie/EmulationStation
```

## external/package/es-theme-carbon/Config.in
```kconfig
config BR2_PACKAGE_ES_THEME_CARBON
	bool "es-theme-carbon"
	depends on BR2_PACKAGE_EMULATIONSTATION
	help
	  Carbon, the default RetroPie theme for EmulationStation.

	  https://github.com/RetroPie/es-theme-carbon
```

## external/package/libretro-atari800/Config.in
```kconfig
config BR2_PACKAGE_LIBRETRO_ATARI800
	bool "libretro-atari800"
	help
	  libretro core: Atari 5200 / 400 / 800 / XL / XE.

	  https://github.com/libretro/libretro-atari800
```

## external/package/libretro-bluemsx/Config.in
```kconfig
config BR2_PACKAGE_LIBRETRO_BLUEMSX
	bool "libretro-bluemsx"
	help
	  libretro core: MSX / MSX2 / ColecoVision / SG-1000.

	  https://github.com/libretro/blueMSX-libretro
```

## external/package/libretro-cap32/Config.in
```kconfig
config BR2_PACKAGE_LIBRETRO_CAP32
	bool "libretro-cap32"
	help
	  libretro core: Amstrad CPC.

	  https://github.com/libretro/libretro-cap32
```

## external/package/libretro-fake08/Config.in
```kconfig
config BR2_PACKAGE_LIBRETRO_FAKE08
	bool "libretro-fake08"
	help
	  libretro core: PICO-8 (fake-08).
```

## external/package/libretro-fbalpha2012/Config.in
```kconfig
config BR2_PACKAGE_LIBRETRO_FBALPHA2012
	bool "libretro-fbalpha2012"
	help
	  libretro core: Arcade (CPS1/CPS2/Neo Geo/...).

	  https://github.com/libretro/fbalpha2012
```

## external/package/libretro-fceumm/Config.in
```kconfig
config BR2_PACKAGE_LIBRETRO_FCEUMM
	bool "libretro-fceumm"
	help
	  libretro core: NES / Famicom.

	  https://github.com/libretro/libretro-fceumm
```

## external/package/libretro-freeintv/Config.in
```kconfig
config BR2_PACKAGE_LIBRETRO_FREEINTV
	bool "libretro-freeintv"
	help
	  libretro core: Intellivision.

	  https://github.com/libretro/FreeIntv
```

## external/package/libretro-fuse/Config.in
```kconfig
config BR2_PACKAGE_LIBRETRO_FUSE
	bool "libretro-fuse"
	help
	  libretro core: ZX Spectrum.

	  https://github.com/libretro/fuse-libretro
```

## external/package/libretro-gambatte/Config.in
```kconfig
config BR2_PACKAGE_LIBRETRO_GAMBATTE
	bool "libretro-gambatte"
	help
	  libretro core: Game Boy / Game Boy Color.

	  https://github.com/libretro/gambatte-libretro
```

## external/package/libretro-genesis-plus-gx/Config.in
```kconfig
config BR2_PACKAGE_LIBRETRO_GENESIS_PLUS_GX
	bool "libretro-genesis-plus-gx"
	help
	  libretro core: Mega Drive / Master System / Game Gear / SG-1000 / Sega CD.

	  https://github.com/libretro/Genesis-Plus-GX
```

## external/package/libretro-gpsp/Config.in
```kconfig
config BR2_PACKAGE_LIBRETRO_GPSP
	bool "libretro-gpsp"
	help
	  libretro core: Game Boy Advance (MIPS dynarec).

	  https://github.com/libretro/gpsp
```

## external/package/libretro-gw/Config.in
```kconfig
config BR2_PACKAGE_LIBRETRO_GW
	bool "libretro-gw"
	help
	  libretro core: Game & Watch.

	  https://github.com/libretro/gw-libretro
```

## external/package/libretro-handy/Config.in
```kconfig
config BR2_PACKAGE_LIBRETRO_HANDY
	bool "libretro-handy"
	help
	  libretro core: Atari Lynx.

	  https://github.com/libretro/libretro-handy
```

## external/package/libretro-mame2003-plus/Config.in
```kconfig
config BR2_PACKAGE_LIBRETRO_MAME2003_PLUS
	bool "libretro-mame2003-plus"
	help
	  libretro core: Arcade (MAME 0.78+).

	  https://github.com/libretro/mame2003-plus-libretro
```

## external/package/libretro-mednafen-pce-fast/Config.in
```kconfig
config BR2_PACKAGE_LIBRETRO_MEDNAFEN_PCE_FAST
	bool "libretro-mednafen-pce-fast"
	help
	  libretro core: PC Engine / TurboGrafx-16 / PCE-CD.

	  https://github.com/libretro/beetle-pce-fast-libretro
```

## external/package/libretro-mednafen-wswan/Config.in
```kconfig
config BR2_PACKAGE_LIBRETRO_MEDNAFEN_WSWAN
	bool "libretro-mednafen-wswan"
	help
	  libretro core: WonderSwan / Color.

	  https://github.com/libretro/beetle-wswan-libretro
```

## external/package/libretro-nestopia/Config.in
```kconfig
config BR2_PACKAGE_LIBRETRO_NESTOPIA
	bool "libretro-nestopia"
	help
	  libretro core: NES / Famicom Disk System.

	  https://github.com/libretro/nestopia
```

## external/package/libretro-nxengine/Config.in
```kconfig
config BR2_PACKAGE_LIBRETRO_NXENGINE
	bool "libretro-nxengine"
	help
	  libretro core: Cave Story.

	  https://github.com/libretro/nxengine-libretro
```

## external/package/libretro-o2em/Config.in
```kconfig
config BR2_PACKAGE_LIBRETRO_O2EM
	bool "libretro-o2em"
	help
	  libretro core: Magnavox Odyssey2 / Videopac.

	  https://github.com/libretro/libretro-o2em
```

## external/package/libretro-pcsx-rearmed/Config.in
```kconfig
config BR2_PACKAGE_LIBRETRO_PCSX_REARMED
	bool "libretro-pcsx-rearmed"
	help
	  libretro core: PlayStation (Lightrec MIPS dynarec).

	  https://github.com/libretro/pcsx_rearmed
```

## external/package/libretro-picodrive/Config.in
```kconfig
config BR2_PACKAGE_LIBRETRO_PICODRIVE
	bool "libretro-picodrive"
	help
	  libretro core: Mega Drive / Master System / Game Gear / Sega CD / 32X.

	  https://github.com/libretro/picodrive
```

## external/package/libretro-pokemini/Config.in
```kconfig
config BR2_PACKAGE_LIBRETRO_POKEMINI
	bool "libretro-pokemini"
	help
	  libretro core: Pokemon Mini.

	  https://github.com/libretro/PokeMini
```
